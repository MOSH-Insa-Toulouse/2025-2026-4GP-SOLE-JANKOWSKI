/*Program which will contain all the code for the Arduino*/

// LIBRARIES

#include <Adafruit_SSD1306.h>
#include <Adafruit_GFX.h> //FOR IMAGES
#include <SPI.h>

/* Read a rotary encoder with interrupts*/ 

#define encoder0PinA  3  //CLK Output A Do not use other pin for clock as we are using interrupt
#define encoder0PinB  4  //DT Output B
#define Switch 2 // Switch connection if available


//POSITION VARIABLES
volatile int encoder0Pos = 0;
int lastEncoderPosMenu = 0;
int ValADC = 0;

const byte csPin           = 10;      // MCP42100 chip select pin
const int  maxPositions    = 256;     // wiper can move from 0 to 255 = 256 positions
const long rAB             = 50000;   // 50k pot resistance between terminals A and B, 
                                      // mais pour ajuster au multimètre, je mets 92500
const byte rWiper          = 125;     // 125 ohms pot wiper resistance
const byte pot0            = 0x11;    // pot0 addr // B 0001 0001
const byte pot0Shutdown    = 0x21;    // pot0 shutdown // B 0010 0001

int potValue = 32;  // start in the middle (0–255) //prover a lage en global variable for bruk i potentiometre

#define nombreDePixelsEnLargeur 128         // Taille de l'écran OLED, en pixel, au niveau de sa largeur
#define nombreDePixelsEnHauteur 64          // Taille de l'écran OLED, en pixel, au niveau de sa hauteur
#define brocheResetOLED         -1          // Reset de l'OLED partagé avec l'Arduino (d'où la valeur à -1, et non un numéro de pin)
#define adresseI2CecranOLED     0x3C        // Adresse de "mon" écran OLED sur le bus i2c (généralement égal à 0x3C ou 0x3D)

Adafruit_SSD1306 ecranOLED(nombreDePixelsEnLargeur, nombreDePixelsEnHauteur, &Wire, brocheResetOLED);

int menuIndex = 0;
const int menuSize = 3;

String menuItems[menuSize] = {
  "Page 1",
  "QR CODE",
  "Exit"
};

bool inMenu = true;

void doEncoder();
float ReadValueGraphite();

void setup() { 

  ////INITIALISING THE DIGITAL POTENTIOMETER////

  Serial.begin(9600);
  Serial.println("MCP41100 Demo");
  
  digitalWrite(csPin, HIGH);        // chip select default to de-selected
  pinMode(csPin, OUTPUT);           // configure chip select as output
  SPI.begin();


    // Initialisation de l'écran OLED
  pinMode(encoder0PinA, INPUT); 
  digitalWrite(encoder0PinA, HIGH);       // turn on pullup resistor

  pinMode(Switch, INPUT_PULLUP); //the button

  pinMode(encoder0PinB, INPUT); 
  digitalWrite(encoder0PinB, HIGH);       // turn on pullup resistor

  attachInterrupt(digitalPinToInterrupt(encoder0PinA), doEncoder, RISING);

  Serial.println("start");      
  
    // Initialisation de l'écran OLED
  if(!ecranOLED.begin(SSD1306_SWITCHCAPVCC, adresseI2CecranOLED))
    while(1);                               // Arrêt du programme (boucle infinie) si échec d'initialisation

    ecranOLED.display();                            // Transfert le buffer à l'écran
    delay(2000); 
    
}
void loop(){

  static int lastPos = 0;

  ////OLED////

  displayMenu();

  if (encoder0Pos != lastEncoderPosMenu) {
    if (encoder0Pos > lastEncoderPosMenu) menuIndex++;
    else menuIndex--;

    if (menuIndex < 0) menuIndex = menuSize - 1;
    if (menuIndex >= menuSize) menuIndex = 0;

    lastEncoderPosMenu = encoder0Pos;
  }
  //code for handling the 'click' function of the rotator

  if (digitalRead(Switch) == LOW) {
  delay(200);

  if (menuIndex == 0) showPage("Dig Pot Control");
  else if (menuIndex == 1) showQRCode();
  else if (menuIndex == 2) return;
  }

  ////ANALOG READ/////
  // read the input on analog pin 0:
  float sensorValue = ReadValueGraphite();
  // print out the value you read:
  Serial.println(sensorValue);
  delay(100);  // delay in between reads for stability

}

float ReadValueGraphite(){
  ValADC = analogRead(A0);
  return ValADC*5.0/1023.0;
}

void doEncoder() {
  if (digitalRead(encoder0PinA)==HIGH && digitalRead(encoder0PinB)==HIGH) {
    encoder0Pos++;
  } else if (digitalRead(encoder0PinA)==HIGH && digitalRead(encoder0PinB)==LOW) {
    encoder0Pos--;
  }
  // Serial.println (encoder0Pos, DEC);  //Angle = (360 / Encoder_Resolution) * encoder0Pos
}

void setPotWiper(int addr, int pos) {
  pos = constrain(pos, 0, 255);            // limit wiper setting to range of 0 to 255
  digitalWrite(csPin, LOW);                // select chip
  SPI.transfer(addr);                      // configure target pot with wiper position
  SPI.transfer(pos);
  digitalWrite(csPin, HIGH);               // de-select chip

  // print pot resistance between wiper and B terminal
  long resistanceWB = ((rAB * pos) / maxPositions ) + rWiper;
  Serial.print("Wiper position: ");
  Serial.print(pos);
  Serial.print(" Resistance wiper to B terminal: ");
  Serial.print(resistanceWB);
  Serial.println(" ohms");
}

////OLED FUNCTIONS////

void displayMenu() {

  //INITIALIZING THE SCREEN
  ecranOLED.clearDisplay();
  ecranOLED.setTextSize(2);
  ecranOLED.setCursor(0, 0);

  for (int i = 0; i < menuSize; i++) {
    if (i == menuIndex) {
      ecranOLED.setTextColor(SSD1306_BLACK, SSD1306_WHITE); // highlight
    } else {
      ecranOLED.setTextColor(SSD1306_WHITE);
    }

    ecranOLED.println(menuItems[i]);
  }

  ecranOLED.display();
}

//// ROTATING ENCODER ////

void showPage(String title) {

  static int lastEncoderPosPot = 0;

  while (digitalRead(Switch) != LOW){

    if (encoder0Pos != lastEncoderPosPot) {
    if (encoder0Pos > lastEncoderPosPot) potValue++;
    else potValue--;

    potValue = constrain(potValue, 0, 255);

    setPotWiper(pot0, potValue);

    lastEncoderPosPot = encoder0Pos;
    }

    //INITIALIZING THE CURRENT DISPLAY
    ecranOLED.clearDisplay();
    ecranOLED.setTextSize(1);
    ecranOLED.setTextColor(SSD1306_WHITE);
    ecranOLED.setCursor(0, 0);

    ecranOLED.println(title);

    ecranOLED.print("Pot value: ");
    ecranOLED.println(potValue);

    long resistanceWB = ((rAB * potValue) / maxPositions ) + rWiper;
    ecranOLED.print("R (ohms): ");
    ecranOLED.println(resistanceWB);

    ecranOLED.display();
    delay(50);
  }
  delay(200); //debouncing
}

// 'QR_code_github', 128x64px
const unsigned char epd_bitmap_QR_code_github [] PROGMEM = {
	0xff, 0xff, 0xff, 0xff, 0xff, 0xff, 0xff, 0xff, 0xff, 0xff, 0xff, 0xff, 0xff, 0xff, 0xff, 0xff, 
	0xe0, 0x01, 0x9e, 0x03, 0x0d, 0x87, 0xe0, 0x01, 0xff, 0xff, 0xff, 0xff, 0xff, 0xff, 0xff, 0xff, 
	0xe0, 0x01, 0x9e, 0x03, 0x09, 0x87, 0xc0, 0x01, 0xff, 0xff, 0xff, 0xff, 0xff, 0xff, 0xff, 0xff, 
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	0xff, 0xff, 0xff, 0xff, 0xff, 0xff, 0xff, 0xff, 0xff, 0xff, 0xff, 0xff, 0xff, 0xff, 0xff, 0xff
};

// Array of all bitmaps for convenience. (Total bytes used to store images in PROGMEM = 1040)
//const int epd_bitmap_allArray_LEN = 1;
//const unsigned char* epd_bitmap_allArray[1] = {
//	epd_bitmap_QR_code_github
//};

void showQRCode() {
  ecranOLED.clearDisplay();

  // Draw bitmap (128x64 full screen)
  ecranOLED.drawBitmap(
    0, 0,
    epd_bitmap_QR_code_github,
    128, 64,
    SSD1306_WHITE
  );

  ecranOLED.display();

  // Wait for button to go back
  while (digitalRead(Switch) != LOW);
  delay(200);
}

/*
   MCP42100 Dual 100K Digital Pot Demo
   Based on examples at https://wiki.dfrobot.com/Dual_Digital_Pot__100K__SKU__DFR0520

   Slowly adjusts pot wipers between min and max (0-255)
   to allow measuring the resistance from the wiper to
   one of the end terminals and to observe the operation of the device.

   Wiper setting is displayed on the serial monitor for confirmation.
   Arduino Uno SPI connections:
   Uno            MCP41100
   ------------------------
   D10           CS  (pin 1)
   D11 (MOSI)    SI  (pin 3)
   D13 (SCK)     SCK (pin 2)
*/
